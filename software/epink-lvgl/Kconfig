## software/epink-lvgl/Kconfig
```kconfig
#
# For a description of the syntax of this configuration file,
# see Documentation/kbuild/kconfig-language.txt.
#
mainmenu "Xenia Clock Configuration"

source "init/Kconfig"

source "net/Kconfig"

source "drivers/Kconfig"

source "fs/Kconfig"

source "misc/Kconfig"
```

## software/epink-lvgl/arch/configs/xeniaclock_defconfig
```kconfig
CONFIG_NET=y
CONFIG_NTP=y
CONFIG_I2C_ENABLE_BUS_0=y
CONFIG_I2C0_SCL_PIN_GP21=y
CONFIG_I2C0_SDA_PIN_GP20=y
CONFIG_I2C_DEBUG_BUS=y
CONFIG_LITTLE_FS=y
CONFIG_LFS_RAMFS=y
CONFIG_LFS_FLASH=y
CONFIG_LFS_FLASH_W25QXX=y
```

## software/epink-lvgl/drivers/Kconfig
```kconfig
#
menu "Device Drivers"

source "drivers/clk/Kconfig"

source "drivers/i2c/Kconfig"

source "drivers/spi/Kconfig"

source "drivers/rtc/Kconfig"

source "drivers/video/Kconfig"

source "drivers/leds/Kconfig"

source "drivers/misc/eeprom/Kconfig"

source "drivers/soc/Kconfig"

source "drivers/uart/Kconfig"

endmenu
```

## software/epink-lvgl/drivers/i2c/Kconfig
```kconfig
menu "I2C support"

# start I2C Bus 0
config I2C_ENABLE_BUS_0
    bool "Enable I2C0"
    help
      Enable the i2c0 support.
      if unsure, Say Y

choice
    prompt "Default SCL Pin"
    depends on I2C_ENABLE_BUS_0
    help
      Here choose the scl pin for default use.

    config I2C0_SCL_PIN_GP1
    bool "GP1"

    config I2C0_SCL_PIN_GP5
    bool "GP5"

    config I2C0_SCL_PIN_GP9
    bool "GP9"

    config I2C0_SCL_PIN_GP13
    bool "GP13"

    config I2C0_SCL_PIN_GP17
    bool "GP17"

    config I2C0_SCL_PIN_GP21
    bool "GP21"

endchoice

config I2C0_DEFAULT_SCL_PIN
    int
    default 1 if I2C0_SCL_PIN_GP1
    default 5 if I2C0_SCL_PIN_GP5
    default 9 if I2C0_SCL_PIN_GP9
    default 17 if I2C0_SCL_PIN_GP17
    default 21 if I2C0_SCL_PIN_GP21

choice
    prompt "Default SDA Pin"
    depends on I2C_ENABLE_BUS_0
    help
      Here choose the sda pin for default use.

    config I2C0_SDA_PIN_GP0
    bool "GP0"

    config I2C0_SDA_PIN_GP4
    bool "GP4"

    config I2C0_SDA_PIN_GP8
    bool "GP8"

    config I2C0_SDA_PIN_GP12
    bool "GP12"

    config I2C0_SDA_PIN_GP16
    bool "GP16"

    config I2C0_SDA_PIN_GP20
    bool "GP20"

endchoice

config I2C0_DEFAULT_SDA_PIN
    int
    default 0 if I2C0_SDA_PIN_GP0
    default 4 if I2C0_SDA_PIN_GP4
    default 8 if I2C0_SDA_PIN_GP8
    default 16 if I2C0_SDA_PIN_GP16
    default 20 if I2C0_SDA_PIN_GP20
# end I2C Bus 0

# start I2C Bus 1



# end I2C Bus 1

config I2C_DEBUG_BUS
    bool "I2C Bus debugging messages"
    help
      Say Y here if you want the I2C bus drivers to produce a bunch of
      debug messages to the system log. Select this if you are having
      a problem with I2C suport and want to see more of what is going
      on.

endmenu
```

## software/epink-lvgl/drivers/video/Kconfig
```kconfig
menu "Graphics support"

config VIDEO_SSD1681
    bool "Enable support for ssd1681 based e-paper display"
    help
      Support ssd1681 e-paper display driver IC.
      If unsure, say Y.

config VIDEO_EP_LUAT
    bool "Enable support for luatos e-paper display"
    help
      Support ssd1681 e-paper display driver IC.
      If unsure, say N.

config VIDEO_ST7789V
    bool "Enable support for st7789v based display"
    help
      Support st7789v display driver IC.
      If unsure, say N.

choice
    prompt "Select default display driver"
    default VIDEO_DEFAULT_DRIVER_SSD1681
    help
      Here to choose the default display driver
      you want to use. If unsure about this, just
      keep default.

config VIDEO_DEFAULT_DRIVER_SSD1681
    bool "ssd1681"
    depends on VIDEO_SSD1681

config VIDEO_DEFAULT_DRIVER_EP_LUAT
    bool "ep_luat"
    depends on VIDEO_EP_LUAT

config VIDEO_DEFAULT_DRIVER_ST7789V
    bool "st7789v"
    depends on VIDEO_ST7789V

endchoice

endmenu
```

## software/epink-lvgl/fs/Kconfig
```kconfig
#
menu "File systems"

menuconfig LITTLE_FS
    bool "LittleFS support"
    default true
    help
      Unless you really know what you are doing, you should say Y here.
      The reason is that most programs need this support to create
      or modify file.

if LITTLE_FS

config LFS_RAMFS
    bool "RAM file system support"
    depends on LITTLE_FS

choice
    prompt "Select default ram block size"
    default LFS_RAMFS_BLOCK_SIZE_64B
    depends on LFS_RAMFS
    help
      Choose the default block size of ram file system.
      In most cases, 64B is enough. if unsure, keep default.

config LFS_RAMFS_BLOCK_SIZE_64B
    bool "64 Byte"

config LFS_RAMFS_BLOCK_SIZE_128B
    bool "128 Byte"

config LFS_RAMFS_BLOCK_SIZE_256B
    bool "256 Byte"
endchoice

config LFS_RAMFS_BLOCK_SIZE
    int
    default 64 if LFS_RAMFS_BLOCK_SIZE_64B
    default 128 if LFS_RAMFS_BLOCK_SIZE_128B
    default 256 if LFS_RAMFS_BLOCK_SIZE_256B

config LFS_FLASH
    bool "Enable LFS flash support"
    depends on LITTLE_FS

config LFS_FLASH_W25QXX
    bool "W25QXX flash support"
    depends on LFS_FLASH

endif  # LITTLE_FS

endmenu
```

## software/epink-lvgl/init/Kconfig
```kconfig
#
menu "Genral setup"

config DEFAULT_USERNAME
	string "Default username"
	default "(none)"
	help
		This option is used to set a default username for ui etc.
		where it should display.

endmenu
```

## software/epink-lvgl/misc/Kconfig
```kconfig
#
menu "Misc settings"

menu "User Settings"
endmenu

menu "Events"
endmenu

menu "Theme"
endmenu

menu "Timers"
endmenu

endmenu
```

## software/epink-lvgl/net/Kconfig
```kconfig
#
menuconfig NET
	bool "Networking support"
	help
      Unless you really know what you are doing, you should say Y here.
      The reason is that some programs need kernel networking support even
      when running on a stand-alone machine that isn't connected to any 
      other computer.

if NET

# menu "Networking options"
choice
	prompt "Select default network module"
	default NET_MODULE_ESP01S

config NET_MODULE_ESP01S
	bool "esp01s"
	help
		Set default network module to esp01s,
		if unsure, choose this one.

config NET_MODULE_ESP32
	bool "esp32"
	help
	  set default network module to esp32

endchoice

choice
	prompt "Module work mode"

config MODULE_MODE_AT
	bool "AT command"

config MODULE_MODE_ESPHOME
	bool "ESPHome"

endchoice

config NTP
	bool "Enable NTP support"
	depends on NET
	help
	  This option makes your device sync time with
	  server though NTP.

	  if unsure, say Y

# endmenu

endif # NET
```
