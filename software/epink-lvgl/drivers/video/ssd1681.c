/**
 * @file ssd1681.c
 * @author IotaHydrae (writeforever@foxmail.com)
 * @brief
 * @version 0.1
 * @date 2022-11-30
 *
 * MIT License
 *
 * Copyright 2022 IotaHydrae(writeforever@foxmail.com)
 *
 * Permission is hereby granted, free of charge, to any person obtaining a copy
 * of this software and associated documentation files (the "Software"), to deal
 * in the Software without restriction, including without limitation the rights
 * to use, copy, modify, merge, publish, distribute, sublicense, and/or sell
 * copies of the Software, and to permit persons to whom the Software is
 * furnished to do so, subject to the following conditions:
 *
 * The above copyright notice and this permission notice shall be included in all
 * copies or substantial portions of the Software.
 *
 * THE SOFTWARE IS PROVIDED "AS IS", WITHOUT WARRANTY OF ANY KIND, EXPRESS OR
 * IMPLIED, INCLUDING BUT NOT LIMITED TO THE WARRANTIES OF MERCHANTABILITY,
 * FITNESS FOR A PARTICULAR PURPOSE AND NONINFRINGEMENT. IN NO EVENT SHALL THE
 * AUTHORS OR COPYRIGHT HOLDERS BE LIABLE FOR ANY CLAIM, DAMAGES OR OTHER
 * LIABILITY, WHETHER IN AN ACTION OF CONTRACT, TORT OR OTHERWISE, ARISING FROM,
 * OUT OF OR IN CONNECTION WITH THE SOFTWARE OR THE USE OR OTHER DEALINGS IN THE
 *
 */

#include <common/vals.h>

#include "video/display_manager.h"
#include "video/epd.h"
#include "hardware/timer.h"
#include "pico/time.h"
#include "pico/multicore.h"

#include "../lvgl/lvgl.h"
#include "../../lv_conf.h"

#if DISPLAY_MAIN_PANEL_USE_SSD1681

#if 0
const unsigned char gImage_1[5000] = { /* 0X01,0X01,0XC8,0X00,0XC8,0X00, */
    0XFF, 0XFF, 0XFF, 0XFF, 0XFF, 0XFF, 0XFF, 0XFF, 0XFF, 0XFF, 0XFF, 0XFF, 0XFF, 0XFF, 0XFF, 0XFF,
    0XFF, 0XFF, 0XFF, 0XFF, 0XFF, 0XFF, 0XFF, 0XFF, 0XFF, 0XFF, 0XFF, 0XFF, 0XFF, 0XFF, 0XFF, 0XFF,
    0XFF, 0XFF, 0XFF, 0XFF, 0XFF, 0XFF, 0XFF, 0XFF, 0XFF, 0XFF, 0XFF, 0XFF, 0XFF, 0XFF, 0XFF, 0XFF,
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    0XFF, 0XFF, 0XFF, 0XFF, 0XFF, 0XFF, 0XFF, 0XFF,
};

const unsigned char gImage_basemap[5000] = { /* 0X01,0X01,0XC8,0X00,0XC8,0X00, */
    0X00, 0X00, 0X00, 0X00, 0X00, 0X01, 0XFF, 0XFF, 0XFF, 0XFF, 0XFF, 0XFF, 0XFF, 0XFF, 0XFF, 0XFF,
    0XFF, 0XFF, 0XFF, 0XFF, 0XFF, 0XFF, 0XFF, 0XFF, 0XFF, 0X00, 0X00, 0X00, 0X00, 0X00, 0X01, 0XFF,
    0XFF, 0XFF, 0XFF, 0XFF, 0XFF, 0XFF, 0XFF, 0XFF, 0XFF, 0XFF, 0XFF, 0XFF, 0XFF, 0XFF, 0XFF, 0XFF,
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    0XFF, 0XFF, 0XFF, 0XFF, 0XFF, 0XFF, 0XFF, 0XFF,
};

const unsigned char Num[10][256] = {
    //0
    {
        0XFF, 0XFF, 0XFF, 0XFF, 0XFF, 0XFF, 0XFF, 0XFF, 0XFF, 0XFF, 0XFF, 0XFF, 0XFF, 0XFF, 0XFF, 0XFF,
        0XFF, 0XFF, 0XFF, 0XE0, 0X03, 0XFF, 0XFF, 0XFF, 0XFF, 0XFF, 0XFC, 0X00, 0X00, 0X1F, 0XFF, 0XFF,
        0XFF, 0XFF, 0XE0, 0X00, 0X00, 0X03, 0XFF, 0XFF, 0XFF, 0XFF, 0X80, 0X00, 0X00, 0X00, 0XFF, 0XFF,
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        0XFF, 0XFF, 0XFF, 0XFF, 0XFF, 0XFF, 0XFF, 0XFF, 0XFF, 0XFF, 0XFF, 0XFF, 0XFF, 0XFF, 0XFF, 0XFF,
    },
    //1
    {
        0XFF, 0XFF, 0XFF, 0XFF, 0XFF, 0XFF, 0XFF, 0XFF, 0XFF, 0XFF, 0XFF, 0XFF, 0XFF, 0XFF, 0XFF, 0XFF,
        0XFF, 0XFF, 0XFF, 0XFF, 0XFF, 0XFF, 0XFF, 0XFF, 0XFF, 0XFF, 0XFF, 0XFF, 0XFF, 0XFF, 0XFF, 0XFF,
        0XFF, 0XFF, 0XFF, 0XFF, 0XFF, 0XFF, 0XFF, 0XFF, 0XFF, 0XFF, 0XFF, 0XFF, 0XFF, 0XFF, 0XFF, 0XFF,
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        0XFF, 0XFF, 0XFF, 0XFF, 0XFF, 0XFF, 0XFF, 0XFF, 0XFF, 0XFF, 0XFF, 0XFF, 0XFF, 0XFF, 0XFF, 0XFF,
    },
    //2
    {
        0XFF, 0XFF, 0XFF, 0XFF, 0XFF, 0XFF, 0XFF, 0XFF, 0XFF, 0XFF, 0XFF, 0XFF, 0XFF, 0XFF, 0XFF, 0XFF,
        0XFF, 0XFF, 0XFF, 0XFF, 0XFF, 0XFF, 0XE3, 0XFF, 0XFF, 0XFF, 0XC1, 0XFF, 0XFF, 0XFF, 0X83, 0XFF,
        0XFF, 0XFF, 0X00, 0XFF, 0XFF, 0XFE, 0X03, 0XFF, 0XFF, 0XFC, 0X00, 0X7F, 0XFF, 0XFC, 0X03, 0XFF,
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        0XFF, 0XFF, 0XFF, 0XFF, 0XFF, 0XFF, 0XFF, 0XFF, 0XFF, 0XFF, 0XFF, 0XFF, 0XFF, 0XFF, 0XFF, 0XFF,
    },
    //3
    {
        0XFF, 0XFF, 0XFF, 0XFF, 0XFF, 0XFF, 0XFF, 0XFF, 0XFF, 0XFF, 0XFF, 0XFF, 0XFF, 0XFF, 0XFF, 0XFF,
        0XFF, 0XFF, 0XFF, 0XFF, 0XFF, 0XFF, 0XFF, 0XFF, 0XFF, 0XFF, 0XFF, 0XFF, 0XFF, 0XF8, 0X7F, 0XFF,
        0XFF, 0XFE, 0X07, 0XFF, 0XFF, 0XF0, 0X1F, 0XFF, 0XFF, 0XFC, 0X03, 0XFF, 0XFF, 0XE0, 0X0F, 0XFF,
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        0XFF, 0XFF, 0XFF, 0XFF, 0XFF, 0XFF, 0XFF, 0XFF, 0XFF, 0XFF, 0XFF, 0XFF, 0XFF, 0XFF, 0XFF, 0XFF,
    },
    //4
    {
        0XFF, 0XFF, 0XFF, 0XFF, 0XFF, 0XFF, 0XFF, 0XFF, 0XFF, 0XFF, 0XFF, 0XFF, 0XFF, 0X7F, 0XFF, 0XFF,
        0XFF, 0XFF, 0XFF, 0XFF, 0XFC, 0X7F, 0XFF, 0XFF, 0XFF, 0XFF, 0XFF, 0XFF, 0XF8, 0X7F, 0XFF, 0XFF,
        0XFF, 0XFF, 0XFF, 0XFF, 0XE0, 0X7F, 0XFF, 0XFF, 0XFF, 0XFF, 0XFF, 0XFF, 0X80, 0X7F, 0XFF, 0XFF,
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        0XFF, 0XFF, 0XFF, 0XFF, 0XFE, 0X7F, 0XFF, 0XFF, 0XFF, 0XFF, 0XFF, 0XFF, 0XFF, 0XFF, 0XFF, 0XFF,
    },
    //5
    {
        0XFF, 0XFF, 0XFF, 0XFF, 0XFF, 0XFF, 0XFF, 0XFF, 0XFF, 0XFF, 0XFF, 0XFF, 0XFF, 0XFF, 0XFF, 0XFF,
        0XFF, 0XFF, 0XFF, 0XFF, 0XFF, 0XFF, 0XFF, 0XFF, 0XFF, 0XFF, 0XFF, 0XFF, 0XFF, 0XF0, 0X7F, 0XFF,
        0XFF, 0XFF, 0XFF, 0XFF, 0XFF, 0XE0, 0X3F, 0XFF, 0XFF, 0XFF, 0XF0, 0X00, 0X1F, 0XC0, 0X1F, 0XFF,
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        0XFF, 0XFF, 0XFF, 0XFF, 0XFF, 0XFF, 0XFF, 0XFF, 0XFF, 0XFF, 0XFF, 0XFF, 0XFF, 0XFF, 0XFF, 0XFF,
    },
    //6
    {
        0XFF, 0XFF, 0XFF, 0XFF, 0XFF, 0XFF, 0XFF, 0XFF, 0XFF, 0XFF, 0XFF, 0XFF, 0XFF, 0XFF, 0XFF, 0XFF,
        0XFF, 0XFF, 0XFF, 0XF8, 0X01, 0XFF, 0XFF, 0XFF, 0XFF, 0XFF, 0XFE, 0X00, 0X00, 0X07, 0XFF, 0XFF,
        0XFF, 0XFF, 0XF0, 0X00, 0X00, 0X01, 0XFF, 0XFF, 0XFF, 0XFF, 0XC0, 0X00, 0X00, 0X00, 0X7F, 0XFF,
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        0XFF, 0XFF, 0XFF, 0XFF, 0XFF, 0XFF, 0XFF, 0XFF, 0XFF, 0XFF, 0XFF, 0XFF, 0XFF, 0XFF, 0XFF, 0XFF,
    },
    //7
    {
        0XFF, 0XFF, 0XFF, 0XFF, 0XFF, 0XFF, 0XFF, 0XFF, 0XFF, 0XFF, 0XFF, 0XFF, 0XFF, 0XFF, 0XFF, 0XFF,
        0XFF, 0XFF, 0XFF, 0XFF, 0XFF, 0XFF, 0XFF, 0XFF, 0XFF, 0XFF, 0XF3, 0XFF, 0XFF, 0XFF, 0XFF, 0XFF,
        0XFF, 0XFC, 0X03, 0XFF, 0XFF, 0XFF, 0XFF, 0XFF, 0XFF, 0XE0, 0X03, 0XFF, 0XFF, 0XFF, 0XFF, 0XFF,
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        0XFF, 0XFF, 0XFF, 0XFF, 0XFF, 0XFF, 0XFF, 0XFF, 0XFF, 0XFF, 0XFF, 0XFF, 0XFF, 0XFF, 0XFF, 0XFF,
    },
    //8
    {
        0XFF, 0XFF, 0XFF, 0XFF, 0XFF, 0XFF, 0XFF, 0XFF, 0XFF, 0XFF, 0XFF, 0XFF, 0XFF, 0XFF, 0XFF, 0XFF,
        0XFF, 0XFF, 0XFF, 0XFF, 0XFF, 0X01, 0XFF, 0XFF, 0XFF, 0XFF, 0X80, 0XFF, 0XF8, 0X00, 0X7F, 0XFF,
        0XFF, 0XFE, 0X00, 0X3F, 0XF0, 0X00, 0X3F, 0XFF, 0XFF, 0XFC, 0X00, 0X1F, 0XE0, 0X00, 0X1F, 0XFF,
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        0XFF, 0XFF, 0XFF, 0XFF, 0XFF, 0XFF, 0XFF, 0XFF, 0XFF, 0XFF, 0XFF, 0XFF, 0XFF, 0XFF, 0XFF, 0XFF,
    },
    //9
    {
        0XFF, 0XFF, 0XFF, 0XFF, 0XFF, 0XFF, 0XFF, 0XFF, 0XFF, 0XFF, 0XFF, 0XFF, 0XFF, 0XFF, 0XFF, 0XFF,
        0XFF, 0XFF, 0XF0, 0X03, 0XFF, 0XFF, 0XFF, 0XFF, 0XFF, 0XFF, 0X80, 0X00, 0X7F, 0XFF, 0XFF, 0XFF,
        0XFF, 0XFE, 0X00, 0X00, 0X3F, 0XFF, 0X1F, 0XFF, 0XFF, 0XFC, 0X00, 0X00, 0X1F, 0XFC, 0X0F, 0XFF,
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        0XFF, 0XFF, 0XFF, 0XFF, 0XFF, 0XFF, 0XFF, 0XFF, 0XFF, 0XFF, 0XFF, 0XFF, 0XFF, 0XFF, 0XFF, 0XFF,
    }
};

const unsigned char gImage_numdot[256] = { /* 0X01,0X01,0X20,0X00,0X40,0X00, */
    0XFF, 0XFF, 0XFF, 0XFF, 0XFF, 0XFF, 0XFF, 0XFF, 0XFF, 0XFF, 0XFF, 0XFF, 0XFF, 0XFF, 0XFF, 0XFF,
    0XFF, 0XFF, 0XFF, 0XFF, 0XFF, 0XFF, 0XFF, 0XFF, 0XFF, 0XFF, 0XFF, 0XFF, 0XFF, 0XFF, 0XFF, 0XFF,
    0XFF, 0XFF, 0XFF, 0XFF, 0XFF, 0XFF, 0XFF, 0XFF, 0XFF, 0XFF, 0XFF, 0XFF, 0XFF, 0XFF, 0XFF, 0XFF,
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    0XFF, 0XFF, 0XFF, 0XFF, 0XFF, 0XFF, 0XFF, 0XFF, 0XFF, 0XFF, 0XFF, 0XFF, 0XFF, 0XFF, 0XFF, 0XFF,
};


void EPD_Dis_Part_myself(unsigned int x_startA, unsigned int y_startA,
                         const unsigned char *datasA,
                         unsigned int x_startB, unsigned int y_startB, const unsigned char *datasB,
                         unsigned int x_startC, unsigned int y_startC, const unsigned char *datasC,
                         unsigned int x_startD, unsigned int y_startD, const unsigned char *datasD,
                         unsigned int x_startE, unsigned int y_startE, const unsigned char *datasE,
                         unsigned int PART_COLUMN, unsigned int PART_LINE
                        )
{
    unsigned int i;
    unsigned int x_end, y_start1, y_start2, y_end1, y_end2;
    
    //Data A////////////////////////////
    x_startA = x_startA / 8; //Convert to byte
    x_end = x_startA + PART_LINE / 8 - 1;
    
    y_start1 = 0;
    y_start2 = y_startA - 1;
    if (y_startA >= 256) {
        y_start1 = y_start2 / 256;
        y_start2 = y_start2 % 256;
    }
    y_end1 = 0;
    y_end2 = y_startA + PART_COLUMN - 1;
    if (y_end2 >= 256) {
        y_end1 = y_end2 / 256;
        y_end2 = y_end2 % 256;
    }
    //Reset
    epink_reset();
    
    epink_write_command(0x3C); //BorderWavefrom
    epink_write_data(0x80);
    //
    epink_write_command(0x44);       // set RAM x address start/end, in page 35
    epink_write_data(x_startA);    // RAM x address start at 00h;
    epink_write_data(x_end);    // RAM x address end at 0fh(15+1)*8->128
    epink_write_command(0x45);       // set RAM y address start/end, in page 35
    epink_write_data(y_start2);    // RAM y address start at 0127h;
    epink_write_data(y_start1);    // RAM y address start at 0127h;
    epink_write_data(y_end2);    // RAM y address end at 00h;
    epink_write_data(y_end1);
    
    
    epink_write_command(0x4E);   // set RAM x address count to 0;
    epink_write_data(x_startA);
    epink_write_command(0x4F);   // set RAM y address count to 0X127;
    epink_write_data(y_start2);
    epink_write_data(y_start1);
    
    
    epink_write_command(0x24);   //Write Black and White image to RAM
    for (i = 0; i < PART_COLUMN * PART_LINE / 8; i++) {
        epink_write_data(datasA[i]);
    }
    //Data B/////////////////////////////////////
    x_startB = x_startB / 8; //Convert to byte
    x_end = x_startB + PART_LINE / 8 - 1;
    
    y_start1 = 0;
    y_start2 = y_startB - 1;
    if (y_startB >= 256) {
        y_start1 = y_start2 / 256;
        y_start2 = y_start2 % 256;
    }
    y_end1 = 0;
    y_end2 = y_startB + PART_COLUMN - 1;
    if (y_end2 >= 256) {
        y_end1 = y_end2 / 256;
        y_end2 = y_end2 % 256;
    }
    
    epink_write_command(0x44);       // set RAM x address start/end, in page 35
    epink_write_data(x_startB);    // RAM x address start at 00h;
    epink_write_data(x_end);    // RAM x address end at 0fh(15+1)*8->128
    epink_write_command(0x45);       // set RAM y address start/end, in page 35
    epink_write_data(y_start2);    // RAM y address start at 0127h;
    epink_write_data(y_start1);    // RAM y address start at 0127h;
    epink_write_data(y_end2);    // RAM y address end at 00h;
    epink_write_data(y_end1);
    
    
    epink_write_command(0x4E);   // set RAM x address count to 0;
    epink_write_data(x_startB);
    epink_write_command(0x4F);   // set RAM y address count to 0X127;
    epink_write_data(y_start2);
    epink_write_data(y_start1);
    
    
    epink_write_command(0x24);   //Write Black and White image to RAM
    for (i = 0; i < PART_COLUMN * PART_LINE / 8; i++) {
        epink_write_data(datasB[i]);
    }
    
    //Data C//////////////////////////////////////
    x_startC = x_startC / 8; //Convert to byte
    x_end = x_startC + PART_LINE / 8 - 1;
    
    y_start1 = 0;
    y_start2 = y_startC - 1;
    if (y_startC >= 256) {
        y_start1 = y_start2 / 256;
        y_start2 = y_start2 % 256;
    }
    y_end1 = 0;
    y_end2 = y_startC + PART_COLUMN - 1;
    if (y_end2 >= 256) {
        y_end1 = y_end2 / 256;
        y_end2 = y_end2 % 256;
    }
    
    epink_write_command(0x44);       // set RAM x address start/end, in page 35
    epink_write_data(x_startC);    // RAM x address start at 00h;
    epink_write_data(x_end);    // RAM x address end at 0fh(15+1)*8->128
    epink_write_command(0x45);       // set RAM y address start/end, in page 35
    epink_write_data(y_start2);    // RAM y address start at 0127h;
    epink_write_data(y_start1);    // RAM y address start at 0127h;
    epink_write_data(y_end2);    // RAM y address end at 00h;
    epink_write_data(y_end1);
    
    
    epink_write_command(0x4E);   // set RAM x address count to 0;
    epink_write_data(x_startC);
    epink_write_command(0x4F);   // set RAM y address count to 0X127;
    epink_write_data(y_start2);
    epink_write_data(y_start1);
    
    
    epink_write_command(0x24);   //Write Black and White image to RAM
    for (i = 0; i < PART_COLUMN * PART_LINE / 8; i++) {
        epink_write_data(datasC[i]);
    }
    
    //Data D//////////////////////////////////////
    x_startD = x_startD / 8; //Convert to byte
    x_end = x_startD + PART_LINE / 8 - 1;
    
    y_start1 = 0;
    y_start2 = y_startD - 1;
    if (y_startD >= 256) {
        y_start1 = y_start2 / 256;
        y_start2 = y_start2 % 256;
    }
    y_end1 = 0;
    y_end2 = y_startD + PART_COLUMN - 1;
    if (y_end2 >= 256) {
        y_end1 = y_end2 / 256;
        y_end2 = y_end2 % 256;
    }
    
    epink_write_command(0x44);       // set RAM x address start/end, in page 35
    epink_write_data(x_startD);    // RAM x address start at 00h;
    epink_write_data(x_end);        // RAM x address end at 0fh(15+1)*8->128
    epink_write_command(0x45);       // set RAM y address start/end, in page 35
    epink_write_data(y_start2);    // RAM y address start at 0127h;
    epink_write_data(y_start1);    // RAM y address start at 0127h;
    epink_write_data(y_end2);    // RAM y address end at 00h;
    epink_write_data(y_end1);
    
    
    epink_write_command(0x4E);   // set RAM x address count to 0;
    epink_write_data(x_startD);
    epink_write_command(0x4F);   // set RAM y address count to 0X127;
    epink_write_data(y_start2);
    epink_write_data(y_start1);
    
    
    epink_write_command(0x24);   //Write Black and White image to RAM
    for (i = 0; i < PART_COLUMN * PART_LINE / 8; i++) {
        epink_write_data(datasD[i]);
    }
    //Data E//////////////////////////////////////
    x_startE = x_startE / 8; //Convert to byte
    x_end = x_startE + PART_LINE / 8 - 1;
    
    y_start1 = 0;
    y_start2 = y_startE - 1;
    if (y_startE >= 256) {
        y_start1 = y_start2 / 256;
        y_start2 = y_start2 % 256;
    }
    y_end1 = 0;
    y_end2 = y_startE + PART_COLUMN - 1;
    if (y_end2 >= 256) {
        y_end1 = y_end2 / 256;
        y_end2 = y_end2 % 256;
    }
    
    epink_write_command(0x44);       // set RAM x address start/end, in page 35
    epink_write_data(x_startE);    // RAM x address start at 00h;
    epink_write_data(x_end);    // RAM x address end at 0fh(15+1)*8->128
    epink_write_command(0x45);       // set RAM y address start/end, in page 35
    epink_write_data(y_start2);    // RAM y address start at 0127h;
    epink_write_data(y_start1);    // RAM y address start at 0127h;
    epink_write_data(y_end2);    // RAM y address end at 00h;
    epink_write_data(y_end1);
    
    
    epink_write_command(0x4E);   // set RAM x address count to 0;
    epink_write_data(x_startE);
    epink_write_command(0x4F);   // set RAM y address count to 0X127;
    epink_write_data(y_start2);
    epink_write_data(y_start1);
    
    
    epink_write_command(0x24);   //Write Black and White image to RAM
    for (i = 0; i < PART_COLUMN * PART_LINE / 8; i++) {
        epink_write_data(datasE[i]);
    }
    
    ssd1681_update_part();
}


void ssd1681_test()
{

    ssd1681_device_init_fast();
    // epink_write_command(0x24);
    // for (uint16_t i = 0; i < 5000; i++) {
    //     epink_write_data(0x0);
    // }
    // ssd1681_update_full();
    // ssd1681_blank();
    
    // for (int x = 0, y = 0; x < 200; x++, y++) {
    //     ssd1681_put_pixel(x, y, EPINK_COLOR_WHITE);
    //     ssd1681_put_pixel(x + 1, y, EPINK_COLOR_BLACK);
    //     ssd1681_put_pixel(x + 2, y, EPINK_COLOR_BLACK);
    //     ssd1681_put_pixel(x + 3, y, EPINK_COLOR_BLACK);
    // }
    
    /* fast flush */
    epink_write_command(0x24);
    for (uint16_t i = 0; i < 5000; i++) {
        epink_write_data(gImage_1[i]);
    }
    ssd1681_update_fast();
    ssd1681_deepsleep();
    // busy_wait_ms(2000);
    
    /* flush a basemap */
    ssd1681_device_init(0);
    epink_write_command(0x24);
    for (uint16_t i = 0; i < 5000; i++) {
        epink_write_data(gImage_basemap[i]);
    }
    ssd1681_update_full();
    
    /* part refresh */
    unsigned char fen_L, fen_H, miao_L, miao_H;
    for (fen_H = 0; fen_H < 6; fen_H++) {
        for (fen_L = 0; fen_L < 10; fen_L++) {
            for (miao_H = 0; miao_H < 6; miao_H++) {
                for (miao_L = 0; miao_L < 10; miao_L++) {
                    EPD_Dis_Part_myself(64, 40, Num[miao_L],       //x-A,y-A,DATA-A
                                        64, 72, Num[miao_H],       //x-B,y-B,DATA-B
                                        64, 112, gImage_numdot,     //x-C,y-C,DATA-C
                                        64, 154, Num[fen_L],       //x-D,y-D,DATA-D
                                        64, 186, Num[fen_H], 32, 64); //x-E,y-E,DATA-E,Resolution 32*64
                                        
                    if ((fen_L == 0) && (miao_H == 0) && (miao_L == 5))
                        goto Clear;
                }
            }
        }
        
    }
Clear:
    ssd1681_deepsleep();
    // busy_wait_ms(2000);
}
#endif

#define DRV_NAME "ssd1681"

void ssd1681_set_window(uint8_t x1, uint8_t y1, uint8_t x2, uint8_t y2)
{
    epink_write_command( 0x44 );
    epink_write_data( ( x1 >> 3 ) & 0xFF );
    epink_write_data( ( x2 >> 3 ) & 0xFF );
    
    /* set start/end position address of y in ram */
    epink_write_command( 0x45 );
    epink_write_data( y1 & 0xFF );
    epink_write_data( ( y1 >> 8 ) & 0xFF );
    epink_write_data( y2 & 0xFF );
    epink_write_data( ( y2 >> 8 ) & 0xFF );
}

void ssd1681_set_cursor(uint8_t x, uint8_t y)
{
    /* set address counter of x in ram */
    epink_write_command( 0x4E );
    epink_write_data( ( x >> 3 ) & 0xFF );
    
    /* set address counter of y in ram */
    epink_write_command( 0x4F );
    epink_write_data( y & 0xFF );
    epink_write_data( ( y >> 8 ) & 0xFF );
}

static void ssd1681_deepsleep()
{
    epink_write_command(0x10);
    epink_write_data(0x01);
    busy_wait_ms(100);
}

#if EPINK_USE_INIT
static void ssd1681_device_init(uint8_t mode)
{
    epink_reset();
    
    epink_write_command(0x12);  /* software reset */
    epink_wait_busy();
    
    epink_write_command(0x01);
    epink_write_data(0xc7);
    epink_write_data(0x00);
    epink_write_data(0x01);
    
    epink_write_command(0x11);
    epink_write_data(0x01);
    
    epink_write_command(0x44);  /* set Ram-X start/end position */
    epink_write_data(0x00); /* x start : 0 */
    epink_write_data(0x18); /* x end : 25 bytes */
    
    epink_write_command(0x45);
    epink_write_data(0xc7); /* 200 rows */
    epink_write_data(0x00);
    epink_write_data(0x00);
    epink_write_data(0x00);
    
    // epink_write_command(0x37);
    // epink_write_data(0x00);
    // epink_write_data(0xff);
    // epink_write_data(0xff);
    // epink_write_data(0xff);
    // epink_write_data(0xff);
    // epink_write_data(0x4f); /* Enable RAM ping-pong mode */
    // epink_write_data(0x00);
    // epink_write_data(0x00);
    // epink_write_data(0x00);
    // epink_write_data(0x00);
    
    epink_write_command(0x3c);
    epink_write_data(0x05);
    
    epink_write_command(0x18);
    epink_write_data(0x80);
    
    epink_write_command(0x4e);
    epink_write_data(0x00);
    epink_write_data(0x4f);
    epink_write_data(0xc7);
    epink_write_data(0x00);
    epink_wait_busy();
    
    epink_write_command(0x22);
    if (mode == EPINK_UPDATE_MODE_FULL)
        epink_write_data(0xf7);
    else
        epink_write_data(0xff);
}

static void ssd1681_device_init_fast(void)
{
    epink_reset();
    
    epink_write_command(0x12);  /* software reset */
    epink_wait_busy();
    
    epink_write_command(0x18);
    epink_write_data(0x80);
    
    epink_write_command(0x22);
    epink_write_data(0xb1);
    epink_write_command(0x20);
    epink_wait_busy();
    
    epink_write_command(0x1a);
    epink_write_data(0x64);
    epink_write_data(0x00);
    
    epink_write_command(0x22);
    epink_write_data(0x91);
    epink_write_command(0x20);
    epink_wait_busy();
}

static int ssd1681_init(uint8_t mode)
{
    multicore_reset_core1();
    ssd1681_device_init(mode);
    
    return 0;
}
#else
static int ssd1681_init(uint8_t mode)
{
    return 0;
}
#endif

static void ssd1681_set_ram_byte(uint16_t x, uint16_t y, uint8_t byte)
{
    epink_write_command(0x44);       // set RAM x address start/end, in page 35
    epink_write_data(0x00);    // RAM x address start at 00h;
    epink_write_data(0x18);    // RAM x address end at 0fh(15+1)*8->128
    epink_write_command(0x45);       // set RAM y address start/end, in page 35
    epink_write_data(0xc7);    // RAM y address start at 0127h;
    epink_write_data(0x00);    // RAM y address start at 0127h;
    epink_write_data(0x00);    // RAM y address end at 00h;
    epink_write_data(0x00);
    
    
    epink_write_command(0x4E);   // set RAM x address count to 0;
    epink_write_data(x);
    epink_write_command(0x4F);   // set RAM y address count to 0X127;
    epink_write_data(y);
    epink_write_data(0);
}

static void ssd1681_update_fast()
{
    pr_debug("%s\n", __DATE__);
    epink_write_command(0x22);
    epink_write_data(0xc7);
    epink_write_command(0x20);
    epink_wait_busy();
}

void ssd1681_update_part_timeout()
{
    pr_debug("%s\n", __DATE__);
    epink_write_command(0x22);
    epink_write_data(0xff);
    epink_write_command(0x20);
    epink_wait_busy_timeout(LV_DISP_DEF_REFR_PERIOD);
}

void ssd1681_update_part()
{
    epink_write_command(0x22);
    epink_write_data(0xff);
    epink_write_command(0x20);
    pr_debug("%s\n", __DATE__);
    epink_wait_busy();
    pr_debug("%s\n", __DATE__);
}

static void ssd1681_update_full()
{
    pr_debug("%s\n", __DATE__);
    epink_write_command(0x22);
    epink_write_data(0xf7);
    epink_write_command(0x20);
    epink_wait_busy();
}

static void ssd1681_update()
{
    pr_debug("%s\n", __DATE__);
    epink_write_command(0x22);
    epink_write_data(0xff);
    epink_write_command(0x20);
    epink_wait_busy();
}

#if EPINK_USE_FLUSH
static void ssd1681_clear(uint16_t color)
{
    // uint8_t width, height;
    // width = ( EPINK_WIDTH % 8 == 0 ) ? ( EPINK_WIDTH / 8 ) :
    //         ( EPINK_WIDTH / 8 + 1 );
    // height = EPINK_HEIGHT;
    
    // ssd1681_set_window( 0, 0, EPINK_WIDTH, EPINK_HEIGHT );
    // epink_write_command( 0x24 );
    
    // for( uint16_t i = 0; i < height; i++ ) {
    //     ssd1681_set_cursor( 0, i );
    
    //     for( uint16_t j = 0; j < width; j++ ) {
    //         epink_write_data( color );
    //     }
    // }
    
    /* Clear RED pixel RAM ? */
    // epink_write_command(0x26);
    // for (uint16_t i = 0; i < EPINK_DISP_BUFFER_SIZE; i++) {
    //     /* flush each line in buffer */
    //     epink_write_data(0xff);
    // }
    epink_write_command(0x24);
    for (uint16_t i = 0; i < EPINK_DISP_BUFFER_SIZE; i++) {
        epink_write_data(color);
    }
    
    ssd1681_update();
}
#else
static void ssd1681_clear(uint8_t color)
{

}
#endif

/**
 * @brief Flush each byte in display buffer to screen
 */
#if EPINK_USE_FLUSH
static bool ssd1681_get_pixel(uint16_t x, uint16_t y)
{
    uint8_t *pen = epink_disp_buffer;
    
    return pen[y * EPINK_LINE_WIDTH_IN_PAGE + (x / EPINK_PAGE_SIZE)] & (0x80 >>
                                                                        (x % EPINK_PAGE_SIZE));
}

static int ssd1681_flush_part(uint16_t xs, uint16_t ys, uint16_t xe, uint16_t ye, void *colorp)
{
    pr_debug("\n");
    uint8_t *pen = epink_disp_buffer;

    epink_reset();
    
    /* BorderWavefrom */
    epink_write_command(0x3c);
    epink_write_data(0x80);

    pr_debug("x1: %d, x2: %d, y1: %d, y2: %d\n", xs, xe, ys, ye);
    ssd1681_set_window(xs, ys, xe, ye);
    for (uint16_t i = ys; i <= ye; i++) {
        ssd1681_set_cursor(xs, (199-i));
        epink_write_command(0x24);

        /* flush each line in buffer */
        for (uint16_t j = (xs / 8); j <= (xe / 8); j++) {
            epink_write_data(pen[j + i * 25]);
        }
    }

    ssd1681_update_part();
    return 0;
}

static int ssd1681_flush_full(void)
{
    pr_debug("\n");
    /* Note: this function is only called when lvgl have
     * a real area update, but this function cost too much time
     * because the `ssd1681_update` function using a while(gpio_get(n))
     * to do a busy check, it caused system blocked, when it came, input event
     * or anything can't timely response. But considering Rp2040 have 2 cores,
     * move this function to another core maybe the best way to solve this problem */
    uint8_t *pen = epink_disp_buffer;
    uint8_t *pen_old = epink_disp_buffer_old;
    uint16_t diff = 0;  /* counter of different  pixel */
    
    static uint32_t flush_count = 0;
    void(*update_method)(void) = ssd1681_update_part;
    
    epink_reset();
    
    /* BorderWavefrom */
    epink_write_command(0x3c);
    epink_write_data(0x80);
    
    // ssd1681_set_window(0, 0, 25, 200);
    /* update window settings */
    epink_write_command(0x44);
    epink_write_data(0x00);
    epink_write_data(0x18);
    epink_write_command(0x45);
    epink_write_data(0xc7);
    epink_write_data(0x00);
    epink_write_data(0x00);
    epink_write_data(0x00);
    
#if 0
    for (uint8_t row = 0; row < 200; row++) {
        for (uint8_t col_in_byte = 0; col_in_byte < 25; col_in_byte++) {
            /* flush each line in buffer */
            if (pen[row + col_in_byte * 25] == pen_old[row + col_in_byte * 25])
                continue;
                
            epink_write_command(0x4e);
            epink_write_data((col_in_byte) & 0x3f);
            
            /* set address counter of y in ram */
            epink_write_command(0x4f);
            epink_write_data((200 - row) & 0xff);
            epink_write_data(((200 - row) >> 8) & 0x01);
            
            epink_write_command(0x24);
            epink_write_data(pen[row + col_in_byte * 25]);
        }
    }
#else
    epink_write_command(0x24);
    for (uint16_t i = 0; i < EPINK_DISP_BUFFER_SIZE; i++) {
        if (pen[i] != pen_old[i])
            diff++;
        epink_write_data(pen[i]);
    }
#endif
    
    // /* Normally, we calling refresh too fast, the current frame
    //  * may be doesn't change anything at all, if so, we don't
    //  * need go further */
    // if (diff == 0) {
    //     pr_debug("skipping this frame\n");
    //     return;
    // }
    
    /* every `period` frame, make a global refresh */
    if ((++flush_count % GLOBAL_REFRESH_PERIOD) == 0) {
        update_method = ssd1681_update_full;
        pr_debug("a full update will be called\n");
    }
    
    /* if there pixels doesn't updated too much,
     * invoke a timeouted update job, maybe caused
     * some error pixels keeping on the screen */
    if (diff < (EPINK_DISP_BUFFER_SIZE / FULL_REFRESH_FACTOR)) {
        update_method = ssd1681_update_part_timeout;
    } else {
        update_method = ssd1681_update_part;
    }
    
    /* invoke target update method */
    update_method();
    
    memcpy(epink_disp_buffer_old, epink_disp_buffer, EPINK_DISP_BUFFER_SIZE);
    
    return 0;
}
#else
static int ssd1681_flush_part()
{
    return 0;
}
static int ssd1681_flush_full()
{
    return 0;
}
#endif

#if EPINK_USE_BLANK
static void ssd1681_blank()
{
    /* flush a basemap */
    // ssd1681_device_init(0);
    // epink_write_command(0x24);
    // for (uint16_t i = 0; i < 5000; i++) {
    //     epink_write_data(gImage_basemap[i]);
    // }
    // ssd1681_update_full();
    // ssd1681_device_init_fast();
    
    // epink_write_command(0x24);
    // for (uint16_t i = 0; i < 5000; i++) {
    //     epink_write_data(0x0);
    // }
    // ssd1681_update_full();
    ssd1681_init(EPINK_UPDATE_MODE_FULL);
    ssd1681_clear(EPINK_COLOR_BLACK);
    ssd1681_clear(EPINK_COLOR_WHITE);
    ssd1681_init(EPINK_UPDATE_MODE_PART);
}
#else
static void ssd1681_blank()
{

}
#endif

#if EPINK_USE_SET_UPDATE_MODE
static void ssd1681_set_update_mode(uint8_t mode)
{

}
#else
static void ssd1681_set_update_mode(uint8_t mode)
{

}
#endif

#if EPINK_USE_PUT_PIXEL
static void ssd1681_put_pixel(uint16_t x, uint16_t y, uint16_t color)
{
    uint8_t *pen = epink_disp_buffer;
    
    if (color)
        pen[y * EPINK_LINE_WIDTH_IN_PAGE + (x / EPINK_PAGE_SIZE)] &= ~(0x80 >>
                                                                       (x % EPINK_PAGE_SIZE));
    else
        pen[y * EPINK_LINE_WIDTH_IN_PAGE + (x / EPINK_PAGE_SIZE)] |= (0x80 >>
                                                                      (x % EPINK_PAGE_SIZE));
}
#else
static void ssd1681_put_pixel(uint16_t x, uint16_t y, uint8_t color)
{

}
#endif

static struct display_module ssd1681_module = {
    .name = DRV_NAME,
    .cfg = {
        .width       = EPINK_WIDTH,
        .height      = EPINK_HEIGHT,
        .bpp         = EPINK_BPP,
        .update_mode = EPINK_UPDATE_MODE_FULL,
    },
    .ops = {
        .module_init            = ssd1681_init,
        .module_blank           = ssd1681_blank,
        .module_clear           = ssd1681_clear,
        .module_flush_part      = ssd1681_flush_part,
        .module_flush           = ssd1681_flush_full,
        .module_put_pixel       = ssd1681_put_pixel,
        .module_set_update_mode = ssd1681_set_update_mode,
    },
};

DISP_MODULE_DRIVER(ssd1681);
#endif
